## package/open-avb/Config.in.host
```kconfig
comment "open-avb needs a toolchain w/ glib, enable c++ and target package w/ pciutils"

config BR2_PACKAGE_OPEN_AVB
	bool "host open-avb"
	depends on BR2_LINUX_KERNEL
	depends on BR2_TOOLCHAIN_USES_GLIBC
	depends on BR2_TOOLCHAIN_BUILDROOT_CXX
	depends on BR2_PACKAGE_PCIUTILS
	select BR2_PACKAGE_LIBTHREAD_STUBS
	select BR2_PACKAGE_LIBPCAP
	select BR2_PACKAGE_ALSA_LIB
	select BR2_PACKAGE_JACK2
	select BR2_PACKAGE_GSTREAMER
	select BR2_PACKAGE_GSTREAMER_GST_DEBUG
	select BR2_PACKAGE_GSTREAMER_PLUGIN_REGISTRY
	select BR2_PACKAGE_GST_PLUGINS_BASE
	select BR2_PACKAGE_READLINE
	help
          This is a comment that explains what Open-AVB is.

	  https://avnu.github.io/Open-AVB
```
